## 6.18.52-VXTux-UMS512/drivers/devfreq/sprd/Kconfig
```kconfig
# SPDX-License-Identifier: GPL-2.0
config SPRD_TOP_DVFS
	tristate "Unisoc TOP DVFS devfreq driver"
	depends on PM_DEVFREQ && COMMON_CLK
	help
	  Hardware DVFS for the Unisoc T618 (UMS512) TOP domain. Replaces the
	  sprd-top-dvfs vendor blob.
	
config SPRD_APSYS_DVFS
	tristate "Unisoc apsys hardware DVFS driver"
	depends on PM_DEVFREQ
	help
	  Hardware DVFS gating for the Unisoc apsys blocks. One driver covering
	  three vendor blobs: apsys-dvfs, sprd_cp_dvfs and sprd_ddr_dvfs.

config SPRD_MM_DVFS
	tristate "Unisoc memory DVFS (mmdvfs)"
	depends on PM_DEVFREQ
	help
	  Hardware DVFS for the Unisoc memory blocks (mtx, isp, fd, cpp, jpg,
	  dcam, dcam_axi, dcam_if). Replaces the mmdvfs vendor blob.

	  One devfreq profile per memory IP, plus a shared PQueue and the
	  per-IP sysfs knobs. The module is named mmdvfs.ko so the stock
	  insmod scripts keep working.
	
```

## 6.18.52-VXTux-UMS512/drivers/soc/sprd/time_sync/Kconfig
```kconfig
# SPDX-License-Identifier: GPL-2.0
#
# Kconfig for the sprd time correction device.

config SPRD_TIME_SYNC
	tristate "Unisoc time correction device (sprd_time_sync)"
	depends on OF && HAS_IOMEM
	select SPRD_SYSTIMER
	default n
	help
	  The sprd_time_sync character device hands out a snapshot of the
	  system clocks - the monotonic time, the boot time, the realtime
	  time, the generic timer counter, the 26MHz systimer counter and
	  the timezone - and can push the same snapshot to userspace as a
	  uevent.
	
	  To compile this driver as a module, choose M here: the module
	  will be called sprd_time_sync.
	
config SPRD_TIME_SYNC_CP
	tristate "Unisoc time correction control point (sprd_time_sync_cp)"
	depends on SPRD_TIME_SYNC
	default n
	help
	  The control point of the time correction device. It offers one
	  entry point that pushes a fresh time snapshot to userspace, so
	  that a daemon can ask for the time without opening the character
	  device.
	
	  To compile this driver as a module, choose M here: the module
	  will be called sprd_time_sync_cp.
	
```

## 6.18.52-VXTux-UMS512/drivers/sound/soc/sprd/audio_pipe/Kconfig
```kconfig
# SPDX-License-Identifier: GPL-2.0
config SPRD_APIPE
	tristate "SPRD audio pipe (apipe)"
	depends on HAS_IOMEM
	help
	  The apipe character device, the replacement for the vendor
	  sprd_apipe.ko.

	  Ported 2026-10-04 from the vendor sources in
	  work/donorcatalog/mods-sprd/sprd/common/audio/audio_pipe/.
	  The register/dispatch contract was recovered from the stock
	  blob with radare2.

	  The stock ROM ships lib/modules/sprd_apipe.ko, so this has to
	  be a loadable module: the blob is insmod'ed by the stock init
	  scripts and the loader looks the file up by name.
```

## 6.18.52-VXTux-UMS512/drivers/unisoc_platform/Kconfig
```kconfig
# SPDX-License-Identifier: GPL-2.0
source "drivers/unisoc_platform/debug_log/Kconfig"
```

## 6.18.52-VXTux-UMS512/drivers/vxtux/disp/sprd_panel_vxtux/Kconfig
```kconfig
# SPDX-License-Identifier: GPL-2.0
config DRM_PANEL_VXTUX_UMS512
	tristate "VXTux generic MIPI-DSI panel (UMS512 1200x2000)"
	depends on DRM && DRM_MIPI_DSI && OF
	help
	  Panel MIPI-DSI generik untuk tablet UMS512 (Advan Tab VX Lite T1030).
	  Melengkapi jalur DRM/KMS murni: DPU (CRTC/plane) -> DSI host -> panel
	  (connector). Mode default 1200x2000; timings/init-sequence vendor
	  menyusul dari DT stok (lihat docs/drm_kms_map.md).
	
```

## 6.18.52-VXTux-UMS512/drivers/vxtux/misc/sprd_map/Kconfig
```kconfig
# SPDX-License-Identifier: GPL-2.0
config SPRD_MAP
	tristate "Unisoc map_user (mmap reserved memory, VXTux port)"
	depends on OF
	help
	  Driver misc map_user Unisoc (port GPL 5.4 -> 6.18). Menyediakan /dev/map_user
	  untuk mmap memori reserved (faceid-mem) oleh userspace vendor. ABI ioctl
	  dipertahankan identik dengan blob.
	
```

## 6.18.52-VXTux-UMS512/drivers/vxtux/mm/hybridswap/Kconfig
```kconfig
# SPDX-License-Identifier: GPL-2.0
config VXTUX_HYBRIDSWAP_REF
	tristate "VXTux: hybridswap (OPLUS) reference port (RE)"
	depends on SWAP && ZSMALLOC && VXTUX_DRIVERS
	default n
	help
	  Port referensi hybridswap OPLUS (blob: hyb.o) — fitur memory-management
	  tambahan, BUKAN boot-kritis. Blob rusak di fork (struct #if konflik,
	  proven Fase 9B) — port ini membersihkannya sebagai dokumentasi hidup.
	  Tetap n kecuali riset zram/zswap UMS512.
	
```

## 6.18.52-VXTux-UMS512/drivers/vxtux/npu/vdsp/Kconfig
```kconfig
# SPDX-License-Identifier: GPL-2.0
#
# drivers/vxtux/npu/vdsp/Kconfig

config SPRD_VDSP
	tristate "Sprd VDSP driver (NPU/video DSP, blob sprd_vdsp.ko)"
	default n
	help
	  Driver DSP video/NPU Unisoc — firmware loader Cadence XRP (xvp),
	  komunikasi IPI, DVFS glue, dan jalur trusty faceid. Firmware
	  vdsp_firmware.bin tersedia di /vendor/firmware perangkat ini.

	  Port dari donor catalog mods-sprd/sprd/kernel4.14/npu/vdsp (GPL,
	  modul donor bernama sprd_vdsp) ke tree 6.18; file donor dipertahankan
	  apa adanya, perubahan API dilakukan minimal.

	  Ini entry ke-103 (terakhir) inventory modul: tanpa konfigurasi ini
	  tally compile berhenti di 102/103. Catatan jujur: varian donor ini
	  memuat inti XRP tanpa subsistem memory/iommu userspace-buffer yang
	  dimiliki varian vendor 5.4 (lihat docs/ledger sprd_vdsp).
```

## 6.18.52-VXTux-UMS512/drivers/vxtux/sound/Kconfig
```kconfig
# SPDX-License-Identifier: GPL-2.0
#
# drivers/vxtux/sound/Kconfig — subsistem sound VXTux

source "drivers/vxtux/sound/asoc/Kconfig"
```

## 6.18.52-VXTux-UMS512/drivers/vxtux/thermal/Kconfig
```kconfig
# SPDX-License-Identifier: GPL-2.0
#
# drivers/vxtux/thermal/Kconfig — model daya GPU hasil RE

config VXTUX_SPRD_GPU_COOLING
	tristate "Spreadtrum GPU devfreq cooling power model (RE)"
	depends on DEVFREQ_THERMAL
	help
	  Model daya GPU Unisoc (SPRD) untuk devfreq_cooling, direkonstruksi
	  dari blob vendor sprd_gpu_cooling.ko (Android 13 / kernel 5.4.210).
	
	  Menyediakan dua ekspor yang sama dengan blob:
	    create_gpu_cooling_device()  -- dipanggil driver GPU
	    destroy_gpu_cooling_device()
	  Model memakai koefisien DT dari node "sprd,mali-power-model"
	  (sprd,temp-scale / sprd,voltage-scale / sprd,core-base /
	   sprd,dynamic-core ...) dan suhu dari zona termal "gpu-thmzone".
	
	  Hasil RE bit-eksak (C == assembly blob) dibuktikan oleh
	  tools/re/re_gpu_cooling_model.py; koefisien papan diambil dari
	  blobs/fdt_live.dtb via tools/re/re_fdt_gpu_cooling.py.
	
	  Driver ini provider ABI tanpa konsumen in-tree (DDK Mali yang
	  memanggilnya tidak ada di pohon ini). Default n.
	
```
